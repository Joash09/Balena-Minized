## conf/bblayers.conf.sample
```bitbake
# POKY_BBLAYERS_CONF_VERSION is increased each time build/conf/bblayers.conf
# changes incompatibly
POKY_BBLAYERS_CONF_VERSION = "2"

BBPATH = "${TOPDIR}"
BBFILES ?= ""

BBLAYERS ?= " \
  /mnt/MyStorage/Balena-Minized/poky/meta \
  /mnt/MyStorage/Balena-Minized/poky/meta-poky \
  /mnt/MyStorage/Balena-Minized/poky/meta-yocto-bsp \
  /mnt/MyStorage/Balena-Minized/meta-openembedded/meta-oe \
  /mnt/MyStorage/Balena-Minized/meta-openembedded/meta-python \
  /mnt/MyStorage/Balena-Minized/meta-openembedded/meta-perl \
  /mnt/MyStorage/Balena-Minized/meta-xilinx/meta-xilinx-bsp \
  /mnt/MyStorage/Balena-Minized/meta-xilinx/meta-xilinx-contrib \
  "
```

## layers/meta-balena-minized/conf/layer.conf
```bitbake
# We have a conf and classes directory, add to BBPATH
BBPATH .= ":${LAYERDIR}"

# We have recipes-* directories, add to BBFILES
BBFILES += "${LAYERDIR}/recipes-*/*/*.bb \
            ${LAYERDIR}/recipes-*/*/*.bbappend"

BBFILE_COLLECTIONS += "meta-balena-minized"
BBFILE_PATTERN_meta-balena-minized = "^${LAYERDIR}/"
BBFILE_PRIORITY_meta-balena-minized = "1337"

LAYERDEPENDS_meta-balena-minized = "core"
LAYERSERIES_COMPAT_meta-balena-minized = "warrior"
```
